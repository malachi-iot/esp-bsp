## components/lcd/esp_lcd_ssd1681/Kconfig
```kconfig
menu "SSD1681"

    choice
        prompt "Chipset"
        default EPD_CHIPSET_SSD1681

        config EPD_CHIPSET_SSD1680
            bool "SSD1680"

        config EPD_CHIPSET_SSD1681
            bool "SSD1681"

    endchoice

    choice
        prompt "Target"
        default BOARD_WAVESHARE

        if EPD_CHIPSET_SSD1681
            config BOARD_WAVESHARE
                bool "Waveshare 1.54 inch v2"
        endif

        if EPD_CHIPSET_SSD1680
            config BOARD_CROWPANEL
                bool "CrowPanel 2.13 inch"
        endif

        config BOARD_CUSTOM
            bool "Custom"

    endchoice


    if BOARD_CUSTOM
        config EPD_WIDTH
            int "Resolution width"
            default 0

        config EPD_HEIGHT
            int "Resolution height"
            default 0
    endif


endmenu
```

## components/lcd/esp_lcd_ssd1681/examples/epaper_demo/main/Kconfig.projbuild
```kconfig
menu "SSD1681 demo"

    config EXAMPLE_SLEEP
        bool "Put display (but not MCU itself) to sleep during test"
        default y
        help
            Display always goes to sleep at end of test
            This flag indicates to sleep the display inbetween full and partial render tests

    if !BOARD_CUSTOM
        config PIN_NUM_EPD_DC
            int
            default 9 if BOARD_WAVESHARE
            default 13 if BOARD_CROWPANEL

        config PIN_NUM_EPD_RST
            int
            default 4 if BOARD_WAVESHARE
            default 10 if BOARD_CROWPANEL

        config PIN_NUM_EPD_CS
            int
            default 10 if BOARD_WAVESHARE
            default 14 if BOARD_CROWPANEL

        config PIN_NUM_EPD_BUSY
            int
            default 18 if BOARD_WAVESHARE
            default 9 if BOARD_CROWPANEL

        config PIN_NUM_EPD_MOSI
            int
            default 7 if BOARD_WAVESHARE
            default 11 if BOARD_CROWPANEL
                
        config PIN_NUM_EPD_SCLK
            int
            default 6 if BOARD_WAVESHARE
            default 12 if BOARD_CROWPANEL
    endif

    if BOARD_CUSTOM
        config PIN_NUM_EPD_DC
            int "DC pin"
        
        config PIN_NUM_EPD_RST
            int "Reset pin"

        config PIN_NUM_EPD_CS
            int "CS pin"

        config PIN_NUM_EPD_BUSY
            int "BUSY pin"

        config PIN_NUM_EPD_MOSI
            int "SPI MOSI"

        config PIN_NUM_EPD_SCLK
            int "SPI SCLK"
    endif

endmenu
```
